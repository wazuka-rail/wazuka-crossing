; Wave table (envelope 0)
    dw          87
    dw          106
    dw          1
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    dw          11
; Wave table (envelope 1)
    dw          74
    dw          90
    dw          1
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    dw          9
; Wave table (envelope 2)
    dw          63
    dw          77
    dw          1
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    dw          8
; Wave table (envelope 3)
    dw          54
    dw          65
    dw          1
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    dw          7
; Wave table (envelope 4)
    dw          46
    dw          56
    dw          1
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    dw          6
; Wave table (envelope 5)
    dw          39
    dw          47
    dw          1
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    dw          5
; Wave table (envelope 6)
    dw          34
    dw          40
    dw          1
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    dw          5
; Wave table (envelope 7)
    dw          29
    dw          35
    dw          1
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    dw          4
; Wave table (envelope 8)
    dw          25
    dw          30
    dw          1
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    dw          4
; Wave table (envelope 9)
    dw          21
    dw          25
    dw          1
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    dw          3
; Wave table (envelope 10)
    dw          18
    dw          22
    dw          1
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    dw          3
; Wave table (envelope 11)
    dw          15
    dw          19
    dw          1
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    dw          3
; Wave table (envelope 12)
    dw          13
    dw          16
    dw          1
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    dw          2
; Wave table (envelope 13)
    dw          11
    dw          14
    dw          1
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    dw          2
; Wave table (envelope 14)
    dw          10
    dw          12
    dw          1
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    dw          2
; Wave table (envelope 15)
    dw          9
    dw          10
    dw          1
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    dw          2
