; LED PFM cycles (V <= ~3.3 V)
    dw          255 ; 3.32 V, 78.4 Hz
    dw          247 ; 3.28 V, 81.0 Hz
    dw          240 ; 3.24 V, 83.3 Hz
    dw          233 ; 3.20 V, 85.8 Hz
    dw          226 ; 3.16 V, 88.5 Hz
    dw          219 ; 3.12 V, 91.3 Hz
    dw          212 ; 3.08 V, 94.3 Hz
    dw          206 ; 3.05 V, 97.1 Hz
    dw          199 ; 3.01 V, 100.5 Hz
    dw          193 ; 2.98 V, 103.6 Hz
    dw          187 ; 2.95 V, 107.0 Hz
    dw          181 ; 2.91 V, 110.5 Hz
    dw          175 ; 2.88 V, 114.3 Hz
    dw          170 ; 2.85 V, 117.6 Hz
    dw          164 ; 2.82 V, 122.0 Hz
    dw          159 ; 2.79 V, 125.8 Hz
    dw          154 ; 2.76 V, 129.9 Hz
    dw          149 ; 2.73 V, 134.2 Hz
    dw          144 ; 2.70 V, 138.9 Hz
    dw          139 ; 2.67 V, 143.9 Hz
    dw          135 ; 2.65 V, 148.1 Hz
    dw          130 ; 2.62 V, 153.8 Hz
    dw          126 ; 2.60 V, 158.7 Hz
    dw          121 ; 2.57 V, 165.3 Hz
    dw          117 ; 2.55 V, 170.9 Hz
    dw          113 ; 2.52 V, 177.0 Hz
    dw          109 ; 2.50 V, 183.5 Hz
    dw          105 ; 2.47 V, 190.5 Hz
    dw          101 ; 2.45 V, 198.0 Hz
    dw          98 ; 2.43 V, 204.1 Hz
    dw          94 ; 2.40 V, 212.8 Hz
    dw          91 ; 2.38 V, 219.8 Hz
    dw          87 ; 2.36 V, 229.9 Hz
    dw          84 ; 2.34 V, 238.1 Hz
    dw          81 ; 2.32 V, 246.9 Hz
    dw          78 ; 2.30 V, 256.4 Hz
    dw          75 ; 2.28 V, 266.7 Hz
    dw          72 ; 2.26 V, 277.8 Hz
    dw          69 ; 2.24 V, 289.9 Hz
    dw          66 ; 2.22 V, 303.0 Hz
    dw          63 ; 2.20 V, 317.5 Hz
    dw          61 ; 2.18 V, 327.9 Hz
    dw          58 ; 2.17 V, 344.8 Hz
    dw          55 ; 2.15 V, 363.6 Hz
    dw          53 ; 2.13 V, 377.4 Hz
    dw          50 ; 2.11 V, 400.0 Hz
    dw          48 ; 2.10 V, 416.7 Hz
    dw          45 ; 2.08 V, 444.4 Hz
    dw          43 ; 2.06 V, 465.1 Hz
    dw          41 ; 2.05 V, 487.8 Hz
    dw          38 ; 2.03 V, 526.3 Hz
    dw          36 ; 2.02 V, 555.6 Hz
    dw          34 ; 2.00 V, 588.2 Hz
    dw          32 ; 1.99 V, 625.0 Hz
    dw          30 ; 1.97 V, 666.7 Hz
    dw          27 ; 1.96 V, 740.7 Hz
    dw          25 ; 1.94 V, 800.0 Hz
    dw          23 ; 1.93 V, 869.6 Hz
    dw          21 ; 1.91 V, 952.4 Hz
    dw          19 ; 1.90 V, 1052.6 Hz
    dw          17 ; 1.89 V, 1176.5 Hz
    dw          15 ; 1.87 V, 1333.3 Hz
    dw          13 ; 1.86 V, 1538.5 Hz
    dw          11 ; 1.85 V, 1818.2 Hz
    dw          9 ; 1.83 V, 2222.2 Hz
    dw          7 ; 1.82 V, 2857.1 Hz
    dw          4 ; 1.81 V, 5000.0 Hz
    dw          2 ; 1.80 V, 10000.0 Hz
    dw          1 ; 1.78 V, 20000.0 Hz
    dw          1 ; 1.77 V, 20000.0 Hz
