; Wave table (envelope 0)
    dw          2
    dw          4
    dw          1
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    dw          1
; Wave table (envelope 1)
    dw          2
    dw          3
    dw          1
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    dw          1
; Wave table (envelope 2)
    dw          1
    dw          3
    dw          1
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    dw          1
; Wave table (envelope 3)
    dw          1
    dw          3
    dw          1
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    dw          1
; Wave table (envelope 4)
    dw          1
    dw          2
    dw          1
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    dw          1
; Wave table (envelope 5)
    dw          1
    dw          2
    dw          1
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    dw          1
; Wave table (envelope 6)
    dw          1
    dw          2
    dw          1
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    dw          1
; Wave table (envelope 7)
    dw          1
    dw          2
    dw          1
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    dw          1
; Wave table (envelope 8)
    dw          1
    dw          2
    dw          1
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    dw          1
; Wave table (envelope 9)
    dw          1
    dw          2
    dw          1
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    dw          1
; Wave table (envelope 10)
    dw          1
    dw          2
    dw          1
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    dw          1
; Wave table (envelope 11)
    dw          1
    dw          1
    dw          1
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    dw          1
; Wave table (envelope 12)
    dw          1
    dw          1
    dw          1
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    dw          1
; Wave table (envelope 13)
    dw          1
    dw          1
    dw          1
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    dw          1
; Wave table (envelope 14)
    dw          1
    dw          1
    dw          1
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    dw          1
; Wave table (envelope 15)
    dw          1
    dw          1
    dw          1
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    dw          1
